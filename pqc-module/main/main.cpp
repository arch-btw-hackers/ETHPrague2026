#include <cstdio>
#include <cstring>
#include <ctime>
#include <cstdlib>

#include "freertos/FreeRTOS.h"
#include "freertos/task.h"

#include "nvs_flash.h"
#include "esp_wifi.h"
#include "esp_event.h"
#include "esp_log.h"
#include "esp_netif.h"

#include "mbedtls/base64.h"

#include "pqc.h"

static const char *TAG = "main";

/* ── Configuration ───────────────────────────────────────────────────────── */

/*
 * Backend KEM public key — provisioned at manufacturing.
 * Replace with the real 800-byte key generated by `make backend-keygen`.
 * Zero placeholder causes the backend to reject all sessions until populated.
 */
static const uint8_t BACKEND_KEM_PK[PQC_KEM_PK_BYTES] = {};

static constexpr char SHIPMENT_ID[]  = "42";
static constexpr char TRACKER_ID[]   = "esp32-demo";
static constexpr float COLD_CHAIN_MAX_TEMP_C = 8.0f;
static constexpr int   BATCH_READINGS        = 8;

/* ── Sensor reading type ─────────────────────────────────────────────────── */

struct SensorReading {
    float   temp_c;
    float   hum_pct;
    int64_t timestamp;
};

static void read_sensor(SensorReading &r)
{
    /* Replace with real DHT22 / SHT31 driver call. */
    r.temp_c    = 3.5f + static_cast<float>(esp_random() % 100) / 100.0f;
    r.hum_pct   = 65.0f;
    r.timestamp = static_cast<int64_t>(std::time(nullptr));
}

/* ── Batch serialization ─────────────────────────────────────────────────── */

static int serialize_batch(
    const SensorReading *readings, int n,
    uint32_t seq,
    char *buf, size_t buf_sz)
{
    int written = std::snprintf(buf, buf_sz,
        R"({"v":1,"shipmentId":"%s","trackerId":"%s","seq":%lu,"readings":[)",
        SHIPMENT_ID, TRACKER_ID, static_cast<unsigned long>(seq));

    for (int i = 0; i < n && written < static_cast<int>(buf_sz) - 64; ++i) {
        written += std::snprintf(buf + written, buf_sz - static_cast<size_t>(written),
            R"(%s{"ts":%lld,"temp_c":%.2f,"hum_pct":%.1f})",
            i ? "," : "",
            static_cast<long long>(readings[i].timestamp),
            readings[i].temp_c,
            readings[i].hum_pct);
    }

    written += std::snprintf(buf + written, buf_sz - static_cast<size_t>(written), "]}");
    return written;
}

static int serialize_aad(uint32_t seq, char *buf, size_t buf_sz)
{
    return std::snprintf(buf, buf_sz,
        R"({"shipmentId":"%s","trackerId":"%s","seq":%lu})",
        SHIPMENT_ID, TRACKER_ID, static_cast<unsigned long>(seq));
}

/* ── Upload ──────────────────────────────────────────────────────────────── */

static void b64_log(const char *label, const uint8_t *data, size_t len)
{
    const size_t b64_sz = ((len + 2) / 3) * 4 + 1;
    auto *b64 = new char[b64_sz];
    size_t out_len = 0;
    mbedtls_base64_encode(
        reinterpret_cast<unsigned char *>(b64), b64_sz, &out_len, data, len);
    b64[out_len] = '\0';
    ESP_LOGI(TAG, "  %s: %s", label, b64);
    delete[] b64;
}

static esp_err_t upload_packet(
    pqc_context_t  &ctx,
    const char     *batch_json, size_t batch_len,
    const char     *aad,        size_t aad_len)
{
    static uint8_t nonce[PQC_NONCE_BYTES];
    static uint8_t ct   [PQC_BATCH_JSON_MAX];
    static uint8_t tag  [PQC_TAG_BYTES];

    esp_err_t err = pqc_encrypt_telemetry(&ctx,
        reinterpret_cast<const uint8_t *>(aad), aad_len,
        reinterpret_cast<const uint8_t *>(batch_json), batch_len,
        nonce, ct, tag);
    if (err != ESP_OK) return err;

    err = pqc_sign_batch(&ctx,
        reinterpret_cast<const uint8_t *>(batch_json), batch_len);
    if (err != ESP_OK) return err;

    /* TODO: replace with esp_http_client POST to CONFIG_BACKEND_URL */
    ESP_LOGI(TAG, "=== Upload packet ===");
    b64_log("kem_ct",     ctx.kem_ct,   PQC_KEM_CT_BYTES);
    b64_log("nonce",      nonce,        PQC_NONCE_BYTES);
    b64_log("aad",        reinterpret_cast<const uint8_t *>(aad), aad_len);
    b64_log("ciphertext", ct,           batch_len);
    b64_log("tag",        tag,          PQC_TAG_BYTES);
    b64_log("sig",        ctx.signature, ctx.sig_len);

    return ESP_OK;
}

/* ── PQC task ────────────────────────────────────────────────────────────── */

static StaticTask_t  s_pqc_task_buf;
static StackType_t   s_pqc_stack[14336 / sizeof(StackType_t)];
static pqc_context_t s_ctx;

static void pqc_task(void * /*arg*/)
{
    SensorReading readings[BATCH_READINGS];
    static char   batch_json[PQC_BATCH_JSON_MAX];
    static char   aad_json[256];
    uint32_t      seq = 0;

    /* ── Provisioning / key load ─────────────────────────────────────────── */
    esp_err_t err = pqc_init(&s_ctx);
    if (err == ESP_ERR_NVS_NOT_FOUND) {
        ESP_LOGW(TAG, "No keys found — generating (provisioning mode)");

        std::memcpy(s_ctx.kem_pk_backend, BACKEND_KEM_PK, PQC_KEM_PK_BYTES);

        err = pqc_generate_keys(&s_ctx);
        if (err != ESP_OK) {
            ESP_LOGE(TAG, "Key generation failed — halting");
            vTaskDelete(nullptr);
        }

        ESP_LOGI(TAG, "--- DSA public key (register on backend) ---");
        b64_log("dsa_pk", s_ctx.dsa_pk_device, PQC_DSA_PK_BYTES);
    } else if (err != ESP_OK) {
        ESP_LOGE(TAG, "pqc_init failed: %s", esp_err_to_name(err));
        vTaskDelete(nullptr);
    }

    /* ── Main telemetry loop ─────────────────────────────────────────────── */
    for (;;) {
        for (int i = 0; i < BATCH_READINGS; ++i) {
            read_sensor(readings[i]);
            vTaskDelay(pdMS_TO_TICKS(30'000));
        }

        err = pqc_establish_session(&s_ctx);
        if (err != ESP_OK) {
            ESP_LOGE(TAG, "Session failed — skipping batch");
            continue;
        }

        const int blen = serialize_batch(
            readings, BATCH_READINGS, seq, batch_json, sizeof(batch_json));
        const int alen = serialize_aad(seq, aad_json, sizeof(aad_json));
        ++seq;

        err = upload_packet(s_ctx, batch_json, static_cast<size_t>(blen),
                             aad_json, static_cast<size_t>(alen));
        if (err != ESP_OK)
            ESP_LOGE(TAG, "Upload failed");

        pqc_zeroize(&s_ctx);
        pqc_load_keys(&s_ctx);
    }
}

/* ── Wi-Fi ───────────────────────────────────────────────────────────────── */

static void wifi_event_handler(void * /*arg*/, esp_event_base_t base,
                                int32_t id, void * /*data*/)
{
    if (base == WIFI_EVENT && id == WIFI_EVENT_STA_START)
        esp_wifi_connect();
    else if (base == IP_EVENT && id == IP_EVENT_STA_GOT_IP)
        ESP_LOGI(TAG, "Wi-Fi connected — RNG entropy available");
}

static void wifi_init()
{
    esp_netif_init();
    esp_event_loop_create_default();
    esp_netif_create_default_wifi_sta();

    wifi_init_config_t cfg = WIFI_INIT_CONFIG_DEFAULT();
    esp_wifi_init(&cfg);

    esp_event_handler_register(WIFI_EVENT, ESP_EVENT_ANY_ID,  wifi_event_handler, nullptr);
    esp_event_handler_register(IP_EVENT,   IP_EVENT_STA_GOT_IP, wifi_event_handler, nullptr);

    wifi_config_t wifi_cfg = {};
    std::strncpy(reinterpret_cast<char *>(wifi_cfg.sta.ssid),
                 CONFIG_WIFI_SSID, sizeof(wifi_cfg.sta.ssid) - 1);
    std::strncpy(reinterpret_cast<char *>(wifi_cfg.sta.password),
                 CONFIG_WIFI_PASSWORD, sizeof(wifi_cfg.sta.password) - 1);

    esp_wifi_set_mode(WIFI_MODE_STA);
    esp_wifi_set_config(WIFI_IF_STA, &wifi_cfg);
    esp_wifi_start();
}

/* ── Entry point — must have C linkage for ESP-IDF ──────────────────────── */

extern "C" void app_main()
{
    esp_err_t err = nvs_flash_init();
    if (err == ESP_ERR_NVS_NO_FREE_PAGES || err == ESP_ERR_NVS_NEW_VERSION_FOUND) {
        nvs_flash_erase();
        nvs_flash_init();
    }

    wifi_init();

    /* Wait for radio entropy before any PQC keygen or encapsulation. */
    vTaskDelay(pdMS_TO_TICKS(3'000));

    xTaskCreateStaticPinnedToCore(
        pqc_task, "pqc",
        sizeof(s_pqc_stack) / sizeof(StackType_t),
        nullptr,
        5,
        s_pqc_stack,
        &s_pqc_task_buf,
        APP_CPU_NUM
    );
}
